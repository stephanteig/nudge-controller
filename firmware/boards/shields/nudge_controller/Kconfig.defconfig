## firmware/boards/shields/nudge_controller/Kconfig.defconfig
```kconfig
# Default Kconfig values applied whenever the Nudge Controller shield is built.
# Users can still override any of these in firmware/nudge_controller.conf.

if SHIELD_NUDGE_CONTROLLER

config ZMK_KEYBOARD_NAME
    # Advertised BLE name. 16 chars; the .conf raises CONFIG_BT_DEVICE_NAME_MAX
    # to 20 so it clears Zephyr's strict name_len < MAX assert.
    default "Nudge Controller"

# Note: the rotary encoder is enabled by CONFIG_EC11=y in nudge_controller.conf
# plus the `alps,ec11` + `zmk,keymap-sensors` nodes in the overlay — no extra
# Kconfig symbol is needed here (the old CONFIG_ZMK_ENCODER no longer exists).

endif # SHIELD_NUDGE_CONTROLLER
```

## firmware/boards/shields/nudge_controller/Kconfig.shield
```kconfig
# Defines the SHIELD_NUDGE_CONTROLLER symbol, switched on automatically when the
# build is invoked with `-DSHIELD=nudge_controller` (or via build.yaml).
config SHIELD_NUDGE_CONTROLLER
    def_bool $(shields_list_contains,nudge_controller)
```

## firmware/west.yml
```yaml
manifest:
  remotes:
    - name: zmkfirmware
      url-base: https://github.com/zmkfirmware
  projects:
    - name: zmk
      remote: zmkfirmware
      revision: main
      import: app/west.yml
  self:
    # Must match config_path (the manifest dir), so `west init -l firmware`
    # resolves the workspace topdir correctly.
    path: firmware
```
